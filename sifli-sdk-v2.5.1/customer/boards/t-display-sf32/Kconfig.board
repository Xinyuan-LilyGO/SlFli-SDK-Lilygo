## sifli-sdk-v2.5.1/t_sf32_display_hw_device/audio_manager_lib/Kconfig
```kconfig
config PKG_USING_AUDIO_MANAGER_LIB
    bool "Enable AUDIO manager library"
    default n
    help
        Audio manager support recording and playback.
```

## sifli-sdk-v2.5.1/t_sf32_display_hw_device/io_expand/Kconfig
```kconfig
menu "IO Expand configuration"

source "$SIFLI_SDK/t_sf32_display_hw_device/io_expand/xl9555/Kconfig"

endmenu
```

## sifli-sdk-v2.5.1/t_sf32_display_hw_device/pa/Kconfig
```kconfig
menu "analog PA configuration"

source "$SIFLI_SDK/t_sf32_display_hw_device/pa/ns4150b/Kconfig"

endmenu
```

## sifli-sdk-v2.5.1/t_sf32_display_hw_device/pa/ns4150b/Kconfig
```kconfig
config PA_USING_NS4150B
    bool  "analog PA NS4150B enable"
    default n
    if PA_USING_NS4150B
        config NS4150B_GPIO_PIN
            int "NS4150B Control PIN"
            default 20
    endif 
```

## sifli-sdk-v2.5.1/t_sf32_display_hw_device/sensor/Kconfig
```kconfig
menu "sensors configuration"

source "$SIFLI_SDK/t_sf32_display_hw_device/sensor/bhi260ap/Kconfig"
source "$SIFLI_SDK/t_sf32_display_hw_device/sensor/bme280/Kconfig"
source "$SIFLI_SDK/t_sf32_display_hw_device/sensor/icm20948/Kconfig"

endmenu
```

## sifli-sdk-v2.5.1/t_sf32_display_hw_device/sensor/icm20948/Kconfig
```kconfig
config PKG_USING_ICM20948
    bool "Enable ICM20948 Sensor"
    default n
    
    select PKG_USING_I2C
    help
        Enable support for icm20948 sensors

    if  PKG_USING_ICM20948
    
        config ICM20948_I2C_BUS_NAME
            string "I2C bus name"
            default "i2c1"

        config ICM20948_IRQ_PIN
            int "ICM20948 IRQ pin number"
            default 27
    endif
```

## sifli-sdk/customer/boards/t-display-sf32/lcpu/Kconfig.board
```kconfig
config BSP_USING_BOARD_T_DISPLAY_SF32
    bool
    select SOC_SF32LB52X
    select BF0_LCPU
    default y

rsource "../Kconfig.board"
```

## sifli-sdk/t_sf32_display_hw_device/Kconfig
```kconfig
menu "T SF32 Display hardware packages"
        
source "$SIFLI_SDK/t_sf32_display_hw_device/lora-radio-driver/Kconfig"
source "$SIFLI_SDK/t_sf32_display_hw_device/charge/Kconfig"
source "$SIFLI_SDK/t_sf32_display_hw_device/input_keyboard/Kconfig"
source "$SIFLI_SDK/t_sf32_display_hw_device/io_expand/Kconfig"
source "$SIFLI_SDK/t_sf32_display_hw_device/gps/Kconfig"
source "$SIFLI_SDK/t_sf32_display_hw_device/pa/Kconfig"
source "$SIFLI_SDK/t_sf32_display_hw_device/sensor/Kconfig"
source "$SIFLI_SDK/t_sf32_display_hw_device/esp_at/Kconfig"
source "$SIFLI_SDK/t_sf32_display_hw_device/motor/Kconfig"
source "$SIFLI_SDK/t_sf32_display_hw_device/infrared/Kconfig"
source "$SIFLI_SDK/t_sf32_display_hw_device/uart_mux/Kconfig"
source "$SIFLI_SDK/t_sf32_display_hw_device/audio_manager_lib/Kconfig"

endmenu
```

## sifli-sdk/t_sf32_display_hw_device/charge/Kconfig
```kconfig
menu "Battery Charge Mangement"

    source "$SIFLI_SDK/t_sf32_display_hw_device/charge/bq21080/Kconfig"
    source "$SIFLI_SDK/t_sf32_display_hw_device/charge/sgm41562b/Kconfig"
endmenu
```

## sifli-sdk/t_sf32_display_hw_device/charge/bq21080/Kconfig
```kconfig
config PKG_USING_BQ21080
    bool "Enable BQ21080 Battery Management"
    default n

    if  PKG_USING_BQ21080
    
        config BQ21080_I2C_BUS_NAME
            string "I2C bus name"
            default "i2c1"

        config BQ21080_IRQ_PIN
            int "BQ21080 IRQ pin number"
            default 27
    endif
```

## sifli-sdk/t_sf32_display_hw_device/esp_at/Kconfig
```kconfig
config PKG_USING_ESP32C6_AT_COMMAND
    bool "Enable ESP32C6 module based on AT library"
    default n
    select PKG_USING_UART
    help
        Enable PKG_USING_ESP32C6_AT_COMMAND library.

    if  PKG_USING_ESP32C6_AT_COMMAND
    
        config ESP32C6_UART_BUS_NAME
            string "UART bus name"
            default "uart2"
    endif
```

## sifli-sdk/t_sf32_display_hw_device/gps/Kconfig
```kconfig
menu "GPS module configuration"

source "$SIFLI_SDK/t_sf32_display_hw_device/gps/lwgps2rtt/Kconfig"
source "$SIFLI_SDK/t_sf32_display_hw_device/gps/TinyGPS/Kconfig"

    config PKG_USING_L76K
        bool "Enable GPS L76K"
        default n

        help
            Enable support for GPS L76K

        if  PKG_USING_L76K        

            config GPS_UART_BUS_NAME
                string "UART bus name"
                default "uart2"
        endif

endmenu
```

## sifli-sdk/t_sf32_display_hw_device/infrared/Kconfig
```kconfig
config PKG_USING_INFRARED
    bool "Enable INFRARED_MYSELF library"
    default n

    if  PKG_USING_INFRARED
    
        config INFRARED_PWM_NAME
            string "irfrared pwm name"
            default "pwm3"
    
        config INFRARED_PWM_CHANNEL
            int "irfrared pwm channel"
            default 1
    endif
```

## sifli-sdk/t_sf32_display_hw_device/input_keyboard/Kconfig
```kconfig
menuconfig PKG_USING_PKG_KEY_BOARD
	bool "Key Board"
	default n

    if  PKG_USING_PKG_KEY_BOARD
    
        config KEY_BOARD_I2C_BUS_NAME
            string "I2C bus name"
            default "i2c1"

        config KEY_BOARD_IRQ_PIN
            int "KEY_BOARD IRQ pin number"
            default 11
    endif
```

## sifli-sdk/t_sf32_display_hw_device/lora-radio-driver/Kconfig
```kconfig
menuconfig PKG_USING_LORA_RADIO_DRIVER
    bool "lora_radio_driver: lora chipset(SX126x) driver."
    default n

    if PKG_USING_LORA_RADIO_DRIVER
            
        choice
        prompt "Select LoRa Chip Type"
        default LORA_RADIO_DRIVER_USING_LORA_CHIP_SX126X

        config LORA_RADIO_DRIVER_USING_LORA_CHIP_SX126X
            bool "LoRa Transceiver [SX126X]"

        # config LORA_RADIO_DRIVER_USING_LORA_CHIP_SX127X
        #     bool "LoRa Transceiver [SX127X]"
        endchoice

        if LORA_RADIO_DRIVER_USING_LORA_CHIP_SX126X
            menu "Select Supported LoRa Module [SX126X]"
                menuconfig LORA_RADIO_DRIVER_USING_LORA_MODULE_SFLB52X
                    bool "SFLB52X [SX1262]"
                    default n

                    if LORA_RADIO_DRIVER_USING_LORA_MODULE_SFLB52X
                        
                        comment "LoRa Chip SX1262 (SPI module)"
                            config LORA_RADIO_DRIVER_USING_ON_RTOS_RT_THREAD
                                bool "Use LORA_RADIO RT-Thread"
                                default y

                            config LORA_RADIO_DRIVER_USING_LORA_RADIO_DEBUG
                                bool "Use LORA_RADIO debug"
                                default n

                            config LORA_RADIO_USE_TCXO
                                bool "Enable TCXO as RF Crystal"
                                default y
                    
                            config LORA_RADIO_USE_DIO2_AS_RF_SWITCH_CTRL
                                bool "Enable DIO2_AS_RF_SWITCH_CTRL"
                                default y

                            config LORA_RADIO0_SPI_BUS_NAME
                                string "SPI bus name for LORA_RADIO0"
                                default "spi1"
                            
                            config LORA_RADIO0_DEVICE_NAME
                                string "SPI device name for LORA_RADIO0"
                                default "lora_radio"

                            config LORA_RADIO_GPIO_SETUP_BY_PIN_NUMBER
                                bool "Select LoRa Chip GPIO by Pin Number"
                                default y

                            if LORA_RADIO_GPIO_SETUP_BY_PIN_NUMBER
                                config LORA_RADIO_ENABLE_PIN
                                    int "ENABLE Pin number"
                                    range 0 44
                                    default 26
                                config LORA_RADIO_NSS_PIN
                                    int "NSS Pin number"
                                    range 0 44
                                    default 29
                                config LORA_RADIO_RESET_PIN
                                    int "RESET Pin number"
                                    range 0 44
                                    default 32
                                config LORA_RADIO_DIO1_PIN
                                    int "DIO1 Pin number"
                                    range 0 44
                                    default 30
                                config LORA_RADIO_BUSY_PIN
                                    int "BUSY Pin number"
                                    range 0 44
                                    default 31
                            endif
                    endif
            endmenu        
        endif


    endif
```

## sifli-sdk/t_sf32_display_hw_device/sensor/bhi260ap/Kconfig
```kconfig
config PKG_USING_BHI260AP
    bool "Enable BHI260AP Sensor"
    default n
    select PKG_USING_I2C
    help
        Enable support for Bosch BHI260 series sensors

    if  PKG_USING_BHI260AP
    
        config BHI260AP_I2C_BUS_NAME
            string "I2C bus name"
            default "i2c1"

        config BHI260AP_IRQ_PIN
            int "BHI260AP IRQ pin number"
            default 27
    endif
```

## sifli-sdk/t_sf32_display_hw_device/uart_mux/Kconfig
```kconfig
config PKG_USING_UART_MANGER
    bool "Enable UART manager"
    default n
    select PKG_USING_UART
    help
        Enable PKG_USING_UART_MANGER library.

    if  PKG_USING_UART_MANGER
    
        config UART_BUS_NAME
            string "UART bus name"
            default "uart2"
    endif
```

## sifli-sdk/t_sf32_display_hw_device/uart_mux/gps/TinyGPS/Kconfig
```kconfig
config PKG_USING_TINYGPS
    bool "Enable GPS module based on TinyGPS library"
    default n
    select PKG_USING_UART
    help
        Enable TinyGPS library.

    # if  PKG_USING_TINYGPS
    
    #     config GPS_UART_BUS_NAME
    #         string "UART bus name"
    #         default "uart2"
    # endif
```

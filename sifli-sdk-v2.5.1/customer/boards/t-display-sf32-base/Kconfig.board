## sifli-sdk-v2.5.1/customer/boards/t-display-sf32-base/Kconfig.board
```kconfig
config ASIC
    bool 
    default y 
   
config TOUCH_IRQ_PIN
    int
    default 1

config LCD_PWM_BACKLIGHT_INTERFACE_NAME
    string
    default "pwm2"

config LCD_PWM_BACKLIGHT_CHANEL_NUM
    int
    default 4

if BF0_HCPU && BSP_USING_RTTHREAD && RT_USING_DEVICE

    config PKG_USING_SGM41562B
        bool
        default y
    
    if PKG_USING_SGM41562B
    
    config SGM41562B_USING_RT_DEVICE
        bool
        default y
    
    endif

endif
```

## sifli-sdk-v2.5.1/t_sf32_display_hw_device/infrared/Kconfig
```kconfig
config PKG_USING_INFRARED
    bool "Enable INFRARED_MYSELF library"
    default n
    select BSP_USING_PWM
    select BSP_USING_PWMT2

    if  PKG_USING_INFRARED
    
        config INFRARED_PWM_NAME
            string "irfrared pwm name"
            default "pwmt2"
    
        config INFRARED_PWM_CHANNEL
            int "irfrared pwm channel"
            default 1
    endif
```

## sifli-sdk-v2.5.1/t_sf32_display_hw_device/input_keyboard/Kconfig
```kconfig
menuconfig PKG_USING_PKG_KEY_BOARD
	bool "Key Board"
	default n

    if  PKG_USING_PKG_KEY_BOARD
    
        config KEY_BOARD_I2C_BUS_NAME
            string "I2C bus name"
            default "i2c1"

        config KEY_BOARD_IRQ_PIN
            int "KEY_BOARD IRQ pin number"
            default 11

        config TCA8418_USING_RT_DEVICE
            bool "Register TCA8418 as an RT-Thread device"
            default n
            select PKG_USING_XL9555

        if TCA8418_USING_RT_DEVICE
            config TCA8418_RT_DEVICE_NAME
                string "RT-Thread device name"
                default "tca8418"
        endif
    endif
```

## sifli-sdk-v2.5.1/t_sf32_display_hw_device/rgb/Kconfig
```kconfig
source "$SIFLI_SDK/t_sf32_display_hw_device/rgb/aw21009/Kconfig"
source "$SIFLI_SDK/t_sf32_display_hw_device/rgb/ws2812/Kconfig"
```

## sifli-sdk-v2.5.1/t_sf32_display_hw_device/rgb/aw21009/Kconfig
```kconfig
config PKG_USING_AW21009
    bool "Enable AW21009 LED driver"
    default n
    select PKG_USING_I2C
    help
        Enable the AW21009 six-channel LED driver used by the
        T-SF32 Keyboard board.

if PKG_USING_AW21009

config AW21009_I2C_BUS_NAME
    string "I2C bus name"
    default "i2c1"

config AW21009_I2C_ADDR
    hex "AW21009 7-bit I2C address"
    range 0x20 0x27
    default 0x25
    help
        Address selected by the AW21009 AD0 and AD1 pins.

endif
```

## sifli-sdk-v2.5.1/t_sf32_display_hw_device/rgb/ws2812/Kconfig
```kconfig
config PKG_USING_WS2812
    bool "Enable WS2812 RGB LED driver"
    default n
    select BSP_USING_PWM
    select BSP_USING_PWMT2
    select BSP_PWMT2_UPDATE_USING_DMA
    help
        Drive a WS2812 LED chain with PWMT2 channel 1 update DMA. On
        the T-Display-SF32 this output is GPTIM2_CH1 on PA36 (RGB_D1).

if PKG_USING_WS2812

config WS2812_PWM_DEVICE_NAME
    string "PWM device name"
    default "pwmt2"

config WS2812_LED_COUNT
    int "Number of LEDs"
    range 1 64
    default 4

endif
```

## sifli-sdk-v2.5.1/t_sf32_display_hw_device/sensor/bhi260ap/Kconfig
```kconfig
config PKG_USING_BHI260AP
    bool "Enable BHI260AP Sensor"
    default n
    select PKG_USING_I2C
    help
        Enable support for Bosch BHI260 series sensors

    if  PKG_USING_BHI260AP
    
        config BHI260AP_I2C_BUS_NAME
            string "I2C bus name"
            default "i2c1"

        config BHI260AP_IRQ_PIN
            int "BHI260AP IRQ pin number"
            default 27

        config BHI260AP_USING_RT_SENSOR
            bool "Register BHI260AP in RT-Thread Sensor framework"
            default n
            select RT_USING_SENSOR

        if BHI260AP_USING_RT_SENSOR
            config BHI260AP_RT_SENSOR_NAME
                string "RT-Thread Sensor device suffix"
                default "bhi260"

            config BHI260AP_RT_SENSOR_ODR
                int "Default Sensor output data rate (Hz)"
                range 1 255
                default 100
        endif
    endif
```

## sifli-sdk-v2.5.1/t_sf32_display_hw_device/uart_mux/Kconfig
```kconfig
menuconfig PKG_USING_UART_MANGER
    bool "Enable UART mux"
    default n
    select PKG_USING_UART
    help
        Enable the shared UART multiplexer for GPS and ESP32-C6.

if PKG_USING_UART_MANGER

config UART_BUS_NAME
    string "Shared UART bus name"
    default "uart2"

source "$SIFLI_SDK/t_sf32_display_hw_device/uart_mux/gps/Kconfig"
source "$SIFLI_SDK/t_sf32_display_hw_device/uart_mux/esp_at/Kconfig"

endif
```

## sifli-sdk-v2.5.1/t_sf32_display_hw_device/uart_mux/gps/Kconfig
```kconfig
menuconfig PKG_USING_L76K
    bool "Enable L76K GPS"
    default n
    select PKG_USING_TINYGPS
    help
        Enable L76K GPS support through UART mux.

if PKG_USING_L76K

config L76K_USING_RT_SENSOR
    bool "Register L76K in RT-Thread Sensor framework"
    default n
    select RT_USING_SENSOR
    select PKG_USING_XL9555

if L76K_USING_RT_SENSOR
config L76K_RT_SENSOR_NAME
    string "RT-Thread Sensor device suffix"
    default "l76k"

config L76K_RT_UART_NAME
    string "UART device name used by the adapter"
    default "uart2"

config L76K_RT_BAUDRATE
    int "GPS baud rate"
    default 115200
endif

source "$SIFLI_SDK/t_sf32_display_hw_device/uart_mux/gps/TinyGPS/Kconfig"
source "$SIFLI_SDK/t_sf32_display_hw_device/uart_mux/gps/lwgps2rtt/Kconfig"

endif
```

## sifli-sdk/t_sf32_display_hw_device/RadioLib/Kconfig
```kconfig
menuconfig PKG_USING_RADIOLIB
    bool "RadioLib: LoRa transceiver drivers in C"
    default n
    select RT_USING_SPI
    select RT_USING_PIN

if PKG_USING_RADIOLIB

config RADIOLIB_USING_SX1262
    bool "Enable SX1262"
    default y

config RADIOLIB_USING_LR1121
    bool "Reserve LR1121 API (not implemented)"
    default n

config RADIOLIB_USING_LR2021
    bool "Reserve LR2021 API (not implemented)"
    default n

config RADIOLIB_USING_SX1276
    bool "Reserve SX1276 API (not implemented)"
    default n

if RADIOLIB_USING_SX1262

config RADIOLIB_SPI_BUS_NAME
    string "SPI bus name"
    default "spi1"

config RADIOLIB_SPI_DEVICE_NAME
    string "SPI device name"
    default "radiolib"

config RADIOLIB_SPI_FREQUENCY
    int "SPI frequency (Hz)"
    range 100000 10000000
    default 8000000

config RADIOLIB_ENABLE_PIN
    int "Module enable pin"
    range -1 255
    default 26

config RADIOLIB_NSS_PIN
    int "NSS pin"
    range 0 255
    default 29

config RADIOLIB_DIO1_PIN
    int "DIO1 pin"
    range 0 255
    default 30

config RADIOLIB_BUSY_PIN
    int "BUSY pin"
    range 0 255
    default 31

config RADIOLIB_RESET_PIN
    int "RESET pin"
    range 0 255
    default 32

config RADIOLIB_DEFAULT_FREQUENCY
    int "Default RF frequency (Hz)"
    range 150000000 960000000
    default 868000000

config RADIOLIB_SX1262_USE_DCDC
    bool "Use DC-DC regulator"
    default y

config RADIOLIB_SX1262_USE_DIO2_RF_SWITCH
    bool "Use DIO2 to control RF switch"
    default y

config RADIOLIB_SX1262_TCXO_VOLTAGE_MV
    int "DIO3 TCXO voltage (mV, 0 disables TCXO control)"
    range 0 3300
    default 3000

config RADIOLIB_SX1262_TCXO_DELAY_MS
    int "TCXO startup delay (ms)"
    range 1 100
    default 5

config RADIOLIB_SX1262_BUSY_TIMEOUT_MS
    int "BUSY timeout (ms)"
    range 10 5000
    default 1000

config RADIOLIB_T_DISPLAY_SF32_PINMUX
    bool "Configure T-Display-SF32 PA30/PA31/PA32 pin mux"
    default y

config RADIOLIB_USING_SAMPLES
    bool "Build RadioLib MSH sample"
    depends on FINSH_USING_MSH
    default n

endif

endif
```

## sifli-sdk/t_sf32_display_hw_device/ads1115/Kconfig
```kconfig
config PKG_USING_ADS1115
    bool "Enable ADS1115 ADC driver"
    default n
    select PKG_USING_I2C
    select RT_USING_ADC
    help
        Enable support for the ADS1115 16-bit ADC.

if PKG_USING_ADS1115

config ADS1115_I2C_BUS_NAME
    string "I2C bus name"
    default "i2c1"

config ADS1115_I2C_ADDR
    int "ADS1115 7-bit I2C address"
    range 72 75
    default 72
    help
        Decimal address selected by the ADDR pin: GND=72 (0x48),
        VDD=73 (0x49), SDA=74 (0x4A), SCL=75 (0x4B).

config ADS1115_ADC_DEVICE_NAME
    string "RT-Thread ADC device name"
    default "ads1115"
    help
        Device name used by rt_device_find() and the FinSH adc command.

config ADS1115_ADC_DEFAULT_PGA
    int "Default PGA index for RT-Thread ADC reads"
    range 0 5
    default 1
    help
        0=6.144V, 1=4.096V, 2=2.048V, 3=1.024V,
        4=0.512V, 5=0.256V. The default supports 3.3V inputs.

config ADS1115_ADC_DEFAULT_RATE
    int "Default data-rate index for RT-Thread ADC reads"
    range 0 7
    default 4
    help
        0=8, 1=16, 2=32, 3=64, 4=128, 5=250,
        6=475, 7=860 samples per second.

endif
```

## sifli-sdk/t_sf32_display_hw_device/charge/sgm41562b/Kconfig
```kconfig
config PKG_USING_SGM41562B
    bool "Enable SGM41562B PM."
    default n
    
    if  PKG_USING_SGM41562B
    
        config SGM41562B_I2C_BUS_NAME
            string "I2C bus name"
            default "i2c1"

        config SGM41562B_IRQ_PIN
            int "SGM41562B IRQ pin number"
            default -1

        config SGM41562B_USING_RT_DEVICE
            bool "Register SGM41562B as an RT-Thread device"
            default n

        if SGM41562B_USING_RT_DEVICE
            config SGM41562B_RT_DEVICE_NAME
                string "RT-Thread device name"
                default "sgm41562b"
        endif
    endif
```

## sifli-sdk/t_sf32_display_hw_device/io_expand/xl9555/Kconfig
```kconfig
config PKG_USING_XL9555
    bool "Enable IO Expand XL9555"
    default n
    select PKG_USING_I2C
    help
        Enable support for XL9555 IO Expand.

    if  PKG_USING_XL9555
    
        config XL9555_I2C_BUS_NAME
            string "I2C bus name"
            default "i2c1"

        config XL9555_IRQ_PIN
            int "XL9555 IRQ pin number"
            default -1

        config XL9555_USING_RT_DEVICE
            bool "Register XL9555 as an RT-Thread device"
            default n

        if XL9555_USING_RT_DEVICE
            config XL9555_RT_DEVICE_NAME
                string "RT-Thread device name"
                default "xl9555"
        endif
    endif
```

## sifli-sdk/t_sf32_display_hw_device/motor/Kconfig
```kconfig
choice
    prompt "Haptic motor driver"
    default PKG_USING_AW86224 if FACTORY_HW_USING_KEYBOARD
    default MOTOR_DRIVER_NONE

    config MOTOR_DRIVER_NONE
        bool "None"

    config PKG_USING_AW86224
        bool "AW86224"
        select PKG_USING_I2C
        select PKG_USING_XL9555
        help
            Enable support for the AW86224 haptic motor on the keyboard.

    config PKG_USING_DRV2605
        bool "DRV2605"
        select PKG_USING_I2C
        select PKG_USING_XL9555
        help
            Enable support for the DRV2605 haptic motor on the joypad.

endchoice

if PKG_USING_AW86224
    config AW86224_I2C_BUS_NAME
        string "I2C bus name"
        default "i2c1"

    config AW86224_USING_RT_DEVICE
        bool "Register AW86224 as an RT-Thread device"
        default y if FACTORY_HW_USING_KEYBOARD
        default n

    if AW86224_USING_RT_DEVICE
        config AW86224_RT_DEVICE_NAME
            string "RT-Thread device name"
            default "aw86224"
    endif
endif

if PKG_USING_DRV2605
    config DRV2605_I2C_BUS_NAME
        string "I2C bus name"
        default "i2c1"

    config DRV2605_I2C_MAX_HZ
        int "I2C maximum frequency"
        range 10000 400000
        default 400000
        help
            Use 100 kHz by default for initial hardware communication.

    config DRV2605_ENABLE_PIN
        int "XL9555 M_EN linear pin index"
        range 0 15
        default 11
        help
            Joypad M_EN is connected to XL9555 P13. P13 maps to index 11.

    choice
        prompt "Actuator type"
        default DRV2605_USE_ERM

        config DRV2605_USE_ERM
            bool "ERM (DC eccentric rotating mass)"

        config DRV2605_USE_LRA
            bool "LRA (linear resonant actuator)"
    endchoice

    config DRV2605_LIBRARY
        int "ROM waveform library"
        range 1 7
        default 6 if DRV2605_USE_LRA
        default 1
        help
            DRV2605 ROM library: 1-5 and 7 are ERM, 6 is LRA.
endif
```

## sifli-sdk/t_sf32_display_hw_device/rgb/ws2812/Kconfig
```kconfig
config PKG_USING_WS2812
    bool "Enable WS2812 RGB LED driver"
    default n
    select BSP_USING_PWM
    select BSP_USING_PWM3
    select BSP_PWM3_CC1_USING_DMA
    help
        Drive a WS2812 LED chain with PWM3 channel 1 DMA. On the
        T-Display-SF32 this output is GPTIM2_CH1 on PA36 (RGB_D1).

if PKG_USING_WS2812

config WS2812_PWM_DEVICE_NAME
    string "PWM device name"
    default "pwm3"

config WS2812_LED_COUNT
    int "Number of LEDs"
    range 1 64
    default 4

endif
```

## sifli-sdk/t_sf32_display_hw_device/sensor/bme280/Kconfig
```kconfig
config PKG_USING_BME280
    bool "Enable BME280 Sensor"
    default n

    if  PKG_USING_BME280
    
        config BME280_I2C_BUS_NAME
            string "I2C bus name"
            default "i2c1"

        config BME280_USING_RT_SENSOR
            bool "Register BME280 in RT-Thread Sensor framework"
            default n
            select RT_USING_SENSOR

        if BME280_USING_RT_SENSOR
            config BME280_RT_SENSOR_NAME
                string "RT-Thread Sensor device suffix"
                default "bme280"
        endif
    endif
```

## sifli-sdk/t_sf32_display_hw_device/uart_mux/esp_at/Kconfig
```kconfig
config PKG_USING_ESP32C6_AT_COMMAND
    bool "Enable ESP32-C6 AT command support"
    default n
    help
        Enable ESP32-C6 AT command support through UART mux.
```
